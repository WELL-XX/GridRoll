## Kconfig
```kconfig
# SPDX-License-Identifier: MIT
config GRIDROLL_PAW3222
    bool "GridRoll PAW3222 single-wire input driver"
    default y if DT_HAS_PANDAKB_PAW3222_SDIO_ENABLED
    depends on GPIO && INPUT

config GRIDROLL_PAW3222_LOG_LEVEL
    int "PAW3222 log level (0 off, 1 error, 3 info, 4 debug)"
    range 0 4
    default 3
    depends on GRIDROLL_PAW3222
```

## boards/shields/gridroll/Kconfig.defconfig
```kconfig
if SHIELD_GRIDROLL_LEFT || SHIELD_GRIDROLL_RIGHT
config ZMK_KEYBOARD_NAME
    default "GridRoll"
config ZMK_SPLIT
    default y
config ZMK_POINTING
    default y
endif
if SHIELD_GRIDROLL_RIGHT
config ZMK_SPLIT_ROLE_CENTRAL
    default y
endif
```

## boards/shields/gridroll/Kconfig.shield
```kconfig
config SHIELD_GRIDROLL_LEFT
    def_bool $(shields_list_contains,gridroll_left)
config SHIELD_GRIDROLL_RIGHT
    def_bool $(shields_list_contains,gridroll_right)
```

## config/west.yml
```yaml
manifest:
  version: "1.2"
  remotes:
    - name: cormoran
      url-base: https://github.com/cormoran
    - name: zmkfirmware
      url-base: https://github.com/zmkfirmware
  projects:
    - name: zmk
      remote: cormoran
      revision: 1fc72aaff7a42bd533c1f4c9b3f23c5317c745f4
      import: app/west.yml
    - name: zephyr
      remote: zmkfirmware
      revision: 10ba6d0cb38bc3d258775d27982f707599320085
      clone-depth: 1
      import:
        name-allowlist: [cmsis, hal_nordic, mbedtls, nanopb, tinycrypt]
    - name: zmk-module-runtime-input-processor
      remote: cormoran
      revision: decf628d7ce5ed95b520c650824c28ea9de649c1
    - name: zmk-feature-custom-settings
      remote: cormoran
      revision: c6a7fef3a3be3d3ace5de9a4b0628c6418cd1f3f
  self:
    path: config
```
