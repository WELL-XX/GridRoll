// SPDX-License-Identifier: MIT
#include "gridroll.dtsi"
&kscan0 {
    row-gpios = <&gpio0 29 (GPIO_ACTIVE_HIGH | GPIO_PULL_DOWN)>,
        <&gpio0 31 (GPIO_ACTIVE_HIGH | GPIO_PULL_DOWN)>,
        <&gpio1 6 (GPIO_ACTIVE_HIGH | GPIO_PULL_DOWN)>,
        <&gpio0 26 (GPIO_ACTIVE_HIGH | GPIO_PULL_DOWN)>;
    col-gpios = <&gpio1 11 GPIO_ACTIVE_HIGH>,
        <&gpio1 10 GPIO_ACTIVE_HIGH>,
        <&gpio0 3 GPIO_ACTIVE_HIGH>,
        <&gpio0 28 GPIO_ACTIVE_HIGH>,
        <&gpio1 13 GPIO_ACTIVE_HIGH>,
        <&gpio0 30 GPIO_ACTIVE_HIGH>;
};
&gridroll_transform { col-offset = <0>; };
&left_encoder { status = "okay"; };

